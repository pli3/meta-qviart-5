## conf/machine/lunix.conf
```bitbake
#@TYPE: Machine
#@NAME: qviart
#@DESCRIPTION: Machine configuration for the qviart lunix

IMAGEDIR ?= "update/lunix/cfe"

BRANDTYPE = "QVIART"

CHIPSET = "bcm73625"

require conf/machine/include/qviart.inc

RCNAME = "qviart1"

SOC_FAMILY = "bcm73625"

STB_PLATFORM = "dags73625"

MTD_KERNEL = "mtd2"
MTD_ROOTFS = "mtd0"

ROOTFS_FILE = "oe_rootfs.bin"
```

## conf/machine/lunix3-4k.conf
```bitbake
#@TYPE: Machine
#@NAME: qviart Lunix3-4k galaxy4k
#@DESCRIPTION: Machine configuration for the Lunix3-4k.

CHIP = "7252S"

UPDATE_DIR = "lunix3-4k"

require conf/machine/include/qviart4k.inc

KV = "linux-3.14-28"

MACHINE_FEATURES += "textlcd dvbproxy dvb-c"

CHIPSET = "bcm7439"

MODEL_SIZE = "300mm"

FORCE_REBOOT_OPTION = "reboot"

MACHINE_KERNEL_PR = "r1"

IMAGE_FSTYPES =+ "ext4"
```

## conf/machine/lunix4k.conf
```bitbake
#@TYPE: Machine
#@NAME: qviart lunix 4k (72604)
#@DESCRIPTION: Machine configuration for the lunix 4k.
#

CHIP = "72604"

UPDATE_DIR = "lunix4k"

require conf/machine/include/qviart4k.inc

MACHINE_FEATURES += "textlcd dvb-c"

CHIPSET = "bcm72604"

FORCE_REBOOT_OPTION = "reboot"

MACHINE_KERNEL_PR = "r1"

IMAGE_FSTYPES =+ "ext4"

MACHINE_ESSENTIAL_EXTRA_RDEPENDS += " \
	qviart-dvb-modules-${CHIP} \
"
PREFERRED_VERSION_linux-qviart = "4.1.20"
```

## conf/machine/lunixco.conf
```bitbake
#@TYPE: Machine
#@NAME: qviart
#@DESCRIPTION: Machine configuration for the qviart lunixco

IMAGEDIR ?= "update/lunixco/cfe"

BRANDTYPE = "QVIART"

CHIPSET = "bcm73625"

require conf/machine/include/qviart.inc

RCNAME = "qviart4"

SOC_FAMILY = "bcm73625"

STB_PLATFORM = "dags73625"

MTD_KERNEL = "mtd2"
MTD_ROOTFS = "mtd0"

ROOTFS_FILE = "oe_rootfs.bin"
```
